## examples/ov5647_color_stream/sdkconfig.defaults
```kconfig
CONFIG_CAMERA_OV5647=y
CONFIG_CAMERA_SC2336=y
CONFIG_CAMERA_OV5647_MIPI_RAW8_800X1280_50FPS=y
# CONFIG_CAMERA_OV5647_MIPI_RAW8_800X640_50FPS is not set
# CONFIG_CAMERA_OV5647_MIPI_RAW8_800X800_50FPS is not set
CONFIG_CAMERA_OV5647_CSI_LINESYNC_ENABLE=y
CONFIG_CAM_CTRL_SPI_ENABLE=n




# Managed by Enki ESP Environment
CONFIG_SPIRAM=y
CONFIG_SPIRAM_USE_MALLOC=y
CONFIG_SPIRAM_MODE_HEX=y
CONFIG_SPIRAM_SPEED_200M=y
CONFIG_SPIRAM_MALLOC_ALWAYSINTERNAL=0
CONFIG_PM_SLP_SPIRAM_HALFSLEEP_ENABLED=n
CONFIG_ESP32P4_SELECTS_REV_LESS_V3=y
CONFIG_ESP32P4_REV_MIN_100=y
CONFIG_ESPTOOLPY_FLASHSIZE_16MB=y
CONFIG_PARTITION_TABLE_SINGLE_APP=y
CONFIG_LOG_DEFAULT_LEVEL_INFO=y
CONFIG_LOG_DEFAULT_LEVEL=3
CONFIG_USJ_ENABLE_USB_SERIAL_JTAG=y
# CONFIG_ETH_ENABLED is not set
# CONFIG_ETH_USE_ESP32_EMAC is not set
# CONFIG_ETH_USE_SPI_ETHERNET is not set
# CONFIG_ESP_HOST_WIFI_ENABLED is not set
```
